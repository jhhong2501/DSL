#define L_Wheel 0x04
#define R_Wheel 0x05

// RS485 modbus RTU protocol Communication

static const uint8_t Tx1Pin = 18; //Serial1 tx
static const uint8_t Rx1Pin = 19; //Serial1 rx

uint8_t Tx_Buf[16];
uint8_t Rx_Buf[16];
volatile unsigned char rx_buf_head = 0;

// Real time millis
unsigned long pre_time = 0;
unsigned long now_time = 0;

/*
ISR(USART2_RX_vect) {
    char c = UDR0;
    Rx_Buf[rx_buf_head] = c;
    if (rx_buf_head == 64 - 1)
        rx_buf_head = 0;
    else
        rx_buf_head++;
}
*/
void setup() {
    Serial1.begin(115200);
}

void loop() {
    /* 10sec counter */
    /*
        now_time = millis();
        if (now_time - pre_time > 1000)
        {
            pre_time = now_time;
        }
    */

    /* Read mode */
    /*
        MB_ReadRegFunCode_03H(L_Wheel, 0x202C, 0x0001);
        delay(2000);
    */

    /* Velocity mode */
    /*
        MB_WriteSingleRegFunCode_06H(L_Wheel, 0x2032, 0x0003);    // Left Set Profile Velocity Mode
        delay(10);
        MB_WriteSingleRegFunCode_06H(R_Wheel, 0x2032, 0x0003);    // Right Set Profile Velocity Mode
        delay(10);
        MB_WriteSingleRegFunCode_06H(L_Wheel, 0x2031, 0x0008);    // Left Motor enable
        delay(10);
        MB_WriteSingleRegFunCode_06H(R_Wheel, 0x2031, 0x0008);    // Right Motor enable
        delay(10);
        MB_WriteSingleRegFunCode_06H(L_Wheel, 0x203A, 0x0064);    // Left Set target speed 100RPM(0x0064 = 100)
        delay(10);
        MB_WriteSingleRegFunCode_06H(R_Wheel, 0x203A, 0xFF9C);    // Right Set target speed -100RPM(0xFF9C = -100)
        delay(10);
    */

    /* Absolute Position mode */
    /*
        MB_WriteSingleRegFunCode_06H(L_Wheel, 0x2032, 0x0002);
        delay(1000);
        MB_WriteSingleRegFunCode_06H(L_Wheel, 0x2036, 0x0064);
        delay(1000);
        MB_WriteSingleRegFunCode_06H(L_Wheel, 0x2031, 0x0008);
        delay(1000);
        MB_WriteMultipleRegFunCode_10H(L_Wheel, 0x2034, 0x0000, 0x5000);
        delay(1000);
        MB_WriteSingleRegFunCode_06H(L_Wheel, 0x2031, 0x0010);
        delay(1000);
        Serial1.end();
    */

    /* EBIMU Example */
    /*
        float euler[3];
        if (EBimuAsciiParser(euler, 3))
        {
        Serial.print("\n\r");
        Serial.print(euler[0]);   Serial.print(" ");
        Serial.print(euler[1]);   Serial.print(" ");
        Serial.print(euler[2]);   Serial.print(" ");
        }
        byte buffer [8] ;
        while (Serial2.available() > 0)
        {
        for (uint8_t i = 0 ; i < 8 ; i++)
        {
            buffer[i] = Serial2.read ();
            Serial.write(buffer[i]);
        }
        }
        Serial2.end();
    */
}

static const uint8_t auchCRCHi[] = {
    0x00, 0xC1, 0x81, 0x40, 0x01, 0xC0, 0x80, 0x41, 0x01, 0xC0,
    0x80, 0x41, 0x00, 0xC1, 0x81, 0x40, 0x01, 0xC0, 0x80, 0x41,
    0x00, 0xC1, 0x81, 0x40, 0x00, 0xC1, 0x81, 0x40, 0x01, 0xC0,
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    0x80, 0x41, 0x00, 0xC1, 0x81, 0x40
};

static const uint8_t auchCRCLo[] = {
    0x00, 0xC0, 0xC1, 0x01, 0xC3, 0x03, 0x02, 0xC2, 0xC6, 0x06,
    0x07, 0xC7, 0x05, 0xC5, 0xC4, 0x04, 0xCC, 0x0C, 0x0D, 0xCD,
    0x0F, 0xCF, 0xCE, 0x0E, 0x0A, 0xCA, 0xCB, 0x0B, 0xC9, 0x09,
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    0x43, 0x83, 0x41, 0x81, 0x80, 0x40
};

uint16_t MB_CRC16(uint8_t *pushMsg, uint8_t usDataLen)
{
    uint8_t uchCRCHi = 0xff;
    uint8_t uchCRCLo = 0xff;
    uint8_t uIndex;
    while (usDataLen--)
    {
        uIndex = uchCRCHi ^ *pushMsg++;
        uchCRCHi = uchCRCLo ^ auchCRCHi[uIndex];
        uchCRCLo = auchCRCLo[uIndex];
    }
    return (uchCRCHi << 8 | uchCRCLo);
}

void MB_ReadRegFunCode_03H(uint8_t _addr, uint16_t _reg, uint16_t _num)
{
    uint16_t TxCount = 0;
    uint16_t crc = 0;

    Tx_Buf[TxCount++] = _addr;
    Tx_Buf[TxCount++] = 0x03;
    Tx_Buf[TxCount++] = _reg >> 8;
    Tx_Buf[TxCount++] = _reg;
    Tx_Buf[TxCount++] = _num >> 8;
    Tx_Buf[TxCount++] = _num;

    crc = MB_CRC16((uint8_t*)&Tx_Buf, TxCount);

    Tx_Buf[TxCount++] = crc >> 8;
    Tx_Buf[TxCount++] = crc;
    /* Transmit to ZLAC8015 */
    digitalWrite(Tx1Pin, HIGH);
    for (uint8_t i = 0 ; i < 8 ; i++)
    {
        Serial1.write(Tx_Buf[i]);
    }
    digitalWrite(Tx1Pin, LOW);
    /* Receive from ZLAC8015*/
    /*
        while (Serial1.available() > 0)
        {
        for (uint8_t j = 0 ; j < 7 ; j++)   // Function code 0x03 recevie data is 7
        {
            Rx_Buf[j] = Serial1.read();
        }
        }
        Serial1.flush();

        RX_data[3] = Rx_Buf[3];
        RX_data[2] = Rx_Buf[2];
        RX_data[1] = Rx_Buf[6];
        RX_data[0] = Rx_Buf[5];
    */
}

void MB_WriteSingleRegFunCode_06H(uint8_t _addr, uint16_t _reg, uint16_t _data)
{
    uint16_t TxCount = 0;
    uint16_t crc = 0;
    Tx_Buf[TxCount++] = _addr;            // 역주소에서
    Tx_Buf[TxCount++] = 0x06;             // 기능코드
    Tx_Buf[TxCount++] = _reg >> 8;        // 레지스터 주소 하이 바이트
    Tx_Buf[TxCount++] = _reg;             // 레지스터 주소 로우 바이트
    Tx_Buf[TxCount++] = _data >> 8;       // 레지스터(16bits) 개수가 높은 바이트
    Tx_Buf[TxCount++] = _data;            //로우 바이트

    crc = MB_CRC16((uint8_t*)&Tx_Buf, TxCount);
    Tx_Buf[TxCount++] = crc >> 8;         //crc 하이 바이트
    Tx_Buf[TxCount++] = crc;              //crc  로우 바이트

    digitalWrite(Tx1Pin, HIGH);
    for (uint8_t i = 0 ; i < 8 ; i++)
    {
        Serial1.write(Tx_Buf[i]);
    }
    digitalWrite(Tx1Pin, LOW);
}

void MB_WriteMultipleRegFunCode_10H(uint8_t _addr, uint16_t _reg, uint16_t _num0, uint16_t _num1)
{
    uint16_t TxCount = 0;
    uint16_t crc = 0;

    Tx_Buf[TxCount++] = _addr;            // 역주소에서
    Tx_Buf[TxCount++] = 0x10;             // 기능코드
    Tx_Buf[TxCount++] = _reg >> 8;        // 레지스터 주소 하이 바이트
    Tx_Buf[TxCount++] = _reg;             // 레지스터 주소 로우 바이트
    Tx_Buf[TxCount++] = 0x00;
    Tx_Buf[TxCount++] = 0x02;             // 0x0002 = register address 2개
    Tx_Buf[TxCount++] = 0x04;             // Number of bytes = 4

    Tx_Buf[TxCount++] = _num0 >> 8;       // High 8 bits of data 0
    Tx_Buf[TxCount++] = _num0;
    Tx_Buf[TxCount++] = _num1 >> 8;       // High 8 bits of data 1
    Tx_Buf[TxCount++] = _num1;

    crc = MB_CRC16((uint8_t*)&Tx_Buf, TxCount);
    Tx_Buf[TxCount++] = crc;              // crc 로우 바이트
    Tx_Buf[TxCount++] = crc >> 8;         // crc 하이 바이트

    digitalWrite(Tx1Pin, HIGH);
    for (uint8_t i = 0 ; i < 13 ; i++)
    {
        Serial1.write(Tx_Buf[i]);
    }
    digitalWrite(Tx1Pin, LOW);
}

// 모터 제어를 위한 데이터 송신
/*
    //Left motor encoder counter
    void encoderLeftMotor() {
    if (digitalRead(PIN_ENCOD_A_MOTOR_LEFT) == digitalRead(PIN_ENCOD_B_MOTOR_LEFT)) pos_left++;
    else pos_left--;
    }

    //Right motor encoder counter
    void encoderRightMotor() {
    if (digitalRead(PIN_ENCOD_A_MOTOR_RIGHT) == digitalRead(PIN_ENCOD_B_MOTOR_RIGHT)) pos_right--;
    else pos_right++;
    }

    // setup에 위치
    // Define the rotary encoder for left motor
    pinMode(PIN_ENCOD_A_MOTOR_LEFT, INPUT);
    pinMode(PIN_ENCOD_B_MOTOR_LEFT, INPUT);
    digitalWrite(PIN_ENCOD_A_MOTOR_LEFT, HIGH);                // turn on pullup resistor
    digitalWrite(PIN_ENCOD_B_MOTOR_LEFT, HIGH);
    attachInterrupt(0, encoderLeftMotor, RISING);
    attachInterrupt(1, encoderRightMotor, RISING);

*/
// ob+ ob- oa+ oa- 구분하기

// 엔코더 데이터를 저장하여 rosserial로 송신해야함

// ebimu. 데이터를 수신해서
// gmapping에 필요한 데이터로 계산하여 저장하여 rosserial로 송신해야함.

// dealy 0.00030381sec (0.30381msec)
